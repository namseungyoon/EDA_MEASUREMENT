/* USER CODE BEGIN Header */
/**
  ******************************************************************************
  * @file           : main.c
  * @brief          : Main program body
  ******************************************************************************
  * @attention
  *
  * Copyright (c) 2024 STMicroelectronics.
  * All rights reserved.
  *
  * This software is licensed under terms that can be found in the LICENSE file
  * in the root directory of this software component.
  * If no LICENSE file comes with this software, it is provided AS-IS.
  *
  ******************************************************************************
  */
/* USER CODE END Header */
/* Includes ------------------------------------------------------------------*/
#include "main.h"
#include "adc.h"
#include "dac.h"
#include "dma.h"
#include "fatfs.h"
#include "i2c.h"
#include "spi.h"
#include "tim.h"
#include "usart.h"
#include "gpio.h"

/* Private includes ----------------------------------------------------------*/
/* USER CODE BEGIN Includes */
#include "math.h"
/* USER CODE END Includes */

/* Private typedef -----------------------------------------------------------*/
/* USER CODE BEGIN PTD */

/* USER CODE END PTD */

/* Private define ------------------------------------------------------------*/
/* USER CODE BEGIN PD */
#define fs					128//hz


/* USER CODE END PD */

/* Private macro -------------------------------------------------------------*/
/* USER CODE BEGIN PM */

/* USER CODE END PM */

/* Private variables ---------------------------------------------------------*/

/* USER CODE BEGIN PV */
float ms = 0;
uint8_t sec = 0;
uint16_t min = 0;
uint16_t ms_idx = 0;

/* EDA variables */
float Ids[1394] = {	0.007568, 0.007568, 0.009180, 0.005151, 0.007568, 0.005151, 0.007568, 0.005151, 0.004346, 0.006763,
					0.004346, 0.005151, 0.005957, 0.007568, 0.005151, 0.005151, 0.006763, 0.003540, 0.001929, 0.004346,
					0.001929, 0.005151, 0.005957, 0.003540, 0.003540, 0.005957, 0.003540, 0.005957, 0.005957, 0.003540,
					0.004346, 0.003540, 0.004346, 0.005957, 0.006763, 0.003540, 0.005151, 0.004346, 0.003540, 0.006763,
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					25.607178, 26.130859, 26.590088, 26.992920};

float ln_Ids[1394] = {	-4.883779, -4.883779, -4.690760, -5.268488, -4.883779, -5.268488, -4.883779, -5.268488, -5.438565, -4.996336,
						-5.438565, -5.268488, -5.123187, -4.883779, -5.268488, -5.268488, -4.996336, -5.643618, -6.250916, -5.438565,
						-6.250916, -5.268488, -5.123187, -5.643618, -5.643618, -5.123187, -5.643618, -5.123187, -5.123187, -5.643618,
						-5.438565, -5.643618, -5.438565, -5.123187, -4.996336, -5.643618, -5.268488, -5.438565, -5.643618, -4.996336,
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						3.242873, 3.263117, 3.280539, 3.295575};

int n_Ids = 1394;

uint8_t degree = 5;

float A[1394][6] = {0,};
float B[1394][1] ={0, };
float B_[1394][1] ={0, };
float ln_Ids_[1394] = {0,};
float Ids_[1394] = {0,};

float x = 0;
/* USER CODE END PV */

/* Private function prototypes -----------------------------------------------*/
void SystemClock_Config(void);
/* USER CODE BEGIN PFP */

/* USER CODE END PFP */

/* Private user code ---------------------------------------------------------*/
/* USER CODE BEGIN 0 */

/* USER CODE END 0 */

/**
  * @brief  The application entry point.
  * @retval int
  */
int main(void)
{
  /* USER CODE BEGIN 1 */

  /* USER CODE END 1 */

  /* MCU Configuration--------------------------------------------------------*/

  /* Reset of all peripherals, Initializes the Flash interface and the Systick. */
  HAL_Init();

  /* USER CODE BEGIN Init */

  /* USER CODE END Init */

  /* Configure the system clock */
  SystemClock_Config();

  /* USER CODE BEGIN SysInit */

  /* USER CODE END SysInit */

  /* Initialize all configured peripherals */
  MX_GPIO_Init();
  MX_DMA_Init();
  MX_SPI5_Init();
  MX_FATFS_Init();
  MX_ADC1_Init();
  MX_DAC_Init();
  MX_I2C1_Init();
  MX_I2C2_Init();
  MX_I2C3_Init();
  MX_TIM3_Init();
  MX_USART1_UART_Init();
  /* USER CODE BEGIN 2 */
//  HAL_TIM_Base_Start_IT(&htim3);

  /* USER CODE END 2 */

  /* Infinite loop */
  /* USER CODE BEGIN WHILE */
  while (1)
  {





    /* USER CODE END WHILE */

    /* USER CODE BEGIN 3 */
  }
  /* USER CODE END 3 */
}

/**
  * @brief System Clock Configuration
  * @retval None
  */
void SystemClock_Config(void)
{
  RCC_OscInitTypeDef RCC_OscInitStruct = {0};
  RCC_ClkInitTypeDef RCC_ClkInitStruct = {0};

  /** Configure the main internal regulator output voltage
  */
  __HAL_RCC_PWR_CLK_ENABLE();
  __HAL_PWR_VOLTAGESCALING_CONFIG(PWR_REGULATOR_VOLTAGE_SCALE3);

  /** Initializes the RCC Oscillators according to the specified parameters
  * in the RCC_OscInitTypeDef structure.
  */
  RCC_OscInitStruct.OscillatorType = RCC_OSCILLATORTYPE_HSI|RCC_OSCILLATORTYPE_HSE;
  RCC_OscInitStruct.HSEState = RCC_HSE_ON;
  RCC_OscInitStruct.HSIState = RCC_HSI_ON;
  RCC_OscInitStruct.HSICalibrationValue = RCC_HSICALIBRATION_DEFAULT;
  RCC_OscInitStruct.PLL.PLLState = RCC_PLL_ON;
  RCC_OscInitStruct.PLL.PLLSource = RCC_PLLSOURCE_HSE;
  RCC_OscInitStruct.PLL.PLLM = 4;
  RCC_OscInitStruct.PLL.PLLN = 128;
  RCC_OscInitStruct.PLL.PLLP = RCC_PLLP_DIV2;
  RCC_OscInitStruct.PLL.PLLQ = 2;
  if (HAL_RCC_OscConfig(&RCC_OscInitStruct) != HAL_OK)
  {
    Error_Handler();
  }

  /** Initializes the CPU, AHB and APB buses clocks
  */
  RCC_ClkInitStruct.ClockType = RCC_CLOCKTYPE_HCLK|RCC_CLOCKTYPE_SYSCLK
                              |RCC_CLOCKTYPE_PCLK1|RCC_CLOCKTYPE_PCLK2;
  RCC_ClkInitStruct.SYSCLKSource = RCC_SYSCLKSOURCE_PLLCLK;
  RCC_ClkInitStruct.AHBCLKDivider = RCC_SYSCLK_DIV1;
  RCC_ClkInitStruct.APB1CLKDivider = RCC_HCLK_DIV8;
  RCC_ClkInitStruct.APB2CLKDivider = RCC_HCLK_DIV2;

  if (HAL_RCC_ClockConfig(&RCC_ClkInitStruct, FLASH_LATENCY_4) != HAL_OK)
  {
    Error_Handler();
  }
}

/* USER CODE BEGIN 4 */
int _write(int32_t file, uint8_t *ptr, int32_t len)
{
	HAL_UART_Transmit(&huart1, ptr, len, 20);

	return len;
}

void HAL_TIM_PeriodElapsedCallback(TIM_HandleTypeDef *htim)
{
	if(htim->Instance == TIM3)
	{
		ms = (float)ms_idx/fs;

		printf("%dm %.3fs\r\n", min, sec+ms);
		if(ms_idx >= fs)
		{
			ms_idx = 0;
			sec++;

			if(sec >= 60)
			{
				sec = 0;
				min++;
			}
		}
		ms_idx++;
	}
}

// Modeling Ids
void Modeling_least_square(float Ids, int N, int order, float Ids_)
{
	for(int i_Ids = 0; i_Ids < n_Ids; i_Ids++)
	{
		x = (float)i_Ids;
		A[i_Ids][5] = x * x * x * x * x;
		A[i_Ids][4] = x * x * x * x;
		A[i_Ids][3] = x * x * x;
		A[i_Ids][2] = x * x;
		A[i_Ids][1] = x;
		A[i_Ids][0] = 1;

		B[i_Ids][1] = ln_Ids[i_Ids];

	//		  printf("%d\t%f\t%f\t%f\t%f\t%f\t%f\r\n", i_Ids, X[i_Ids][5], X[i_Ids][4], X[i_Ids][3], X[i_Ids][2], X[i_Ids][1], X[i_Ids][0]);
	}

	//	  float A[7][2] = { {1, 1},
	//			  	  	  	{2, 1},
	//						{3, 1},
	//						{4, 1},
	//						{5, 1},
	//						{6, 1},
	//						{7, 1},
	//						{7, 1} };
	float A_T[6][1394] = {0, };
	float A_T_A[6][6] = {0, };
	float A_T_A_I[6][6] = {0, };
	float A_T_A_I_A_T[6][1394] = {0, };

	float X[6][1] = {0, };

	/* Least Square fitting
	* AX = B
	* X = A^(-1)B
	*   = ( A^(T)A )^(-1)A^(T)B
	*/
	transpose_matrix(1394, 6, A, A_T);

	multiply_matrices(6, 1394, A_T, 1394, 6, A, A_T_A);

	inverse_matrix(6, A_T_A, A_T_A_I);

	multiply_matrices(6, 6, A_T_A_I, 6, 1394, A_T, A_T_A_I_A_T);

	multiply_matrices(6, 1394, A_T_A_I_A_T, 1394, 1, B, X);

	multiply_matrices(1394, 6, A, 6, 1, X, B_);
	print_matrix(1394, 1, B_);

	for(int i_Ids=0; i_Ids<n_Ids; i_Ids++)
	{
		ln_Ids_[i_Ids] = B_[i_Ids][0];
		Ids_[i_Ids] = exp(ln_Ids_[i_Ids]);
	}
}

// Function to calculate the transpose of a matrix
void transpose_matrix(int rows, int cols, float A[rows][cols], float A_transpose[cols][rows]) {
    int i, j;

    for (i = 0; i < rows; i++)
    {
        for (j = 0; j < cols; j++)
        {
            A_transpose[j][i] = A[i][j]; // Swap rows and columns to assign
        }
    }
}

// Function to calculate the product of two matrices
void multiply_matrices(int rows1, int cols1, float A[rows1][cols1], int rows2, int cols2, float B[rows2][cols2], float result[rows1][cols2]) {
    int i, j, k;

    if (cols1 != rows2)
    {
        printf("Error: Number of columns in the first matrix must be equal to the number of rows in the second matrix.\n");
        return;
    }

    for (i = 0; i < rows1; i++)
    {
        for (j = 0; j < cols2; j++)
        {
            result[i][j] = 0; // Initialize the result matrix
            for (k = 0; k < cols1; k++)
            {
                result[i][j] += A[i][k] * B[k][j]; // Matrix multiplication
            }
        }
    }
}

// Function to calculate the inverse of a matrix
void inverse_matrix(int N, float A[N][N], float A_inv[N][N])
{
	float temp[N][2*N]; // Matrix combining the original matrix and the identity matrix
	float factor;

    // Initialize the temp matrix
    for (int i = 0; i < N; i++)
    {
        for (int j = 0; j < 2*N; j++)
        {
            if (j < N)
            {
                temp[i][j] = A[i][j];
            }
            else
            {
                if (j - N == i)
                {
                    temp[i][j] = 1; // Initialize the identity matrix part
                }
                else
                {
                    temp[i][j] = 0;
                }
            }
        }
    }

    // Gaussian elimination
    for (int i = 0; i < N; i++)
    {
        // If the diagonal element is 0, swap rows
        if (temp[i][i] == 0)
        {
            for (int j = i + 1; j < N; j++)
            {
                if (temp[j][i] != 0)
                {
                    // Swap rows
                    for (int k = 0; k < 2*N; k++)
                    {
                    	float temp_swap = temp[i][k];
                        temp[i][k] = temp[j][k];
                        temp[j][k] = temp_swap;
                    }
                    break;
                }
            }
        }
        // Make the diagonal element 1
        factor = temp[i][i];
        for (int j = 0; j < 2*N; j++)
        {
            temp[i][j] /= factor;
        }
        // Make other elements in the same column 0
        for (int j = 0; j < N; j++)
        {
            if (i != j)
            {
                factor = temp[j][i];
                for (int k = 0; k < 2*N; k++)
                {
                    temp[j][k] -= factor * temp[i][k];
                }
            }
        }
    }

    // Extract the inverse matrix
    for (int i = 0; i < N; i++)
    {
        for (int j = 0; j < N; j++)
        {
            A_inv[i][j] = temp[i][j+N];
        }
    }
}

// Function to print a matrix
void print_matrix(int rows, int cols, float matrix[rows][cols]) {
    int i, j;
    for (i = 0; i < rows; i++)
    {
        for (j = 0; j < cols; j++)
        {
            printf("%f ", matrix[i][j]);
        }
        printf("\r\n");
    }
}


/* USER CODE END 4 */

/**
  * @brief  This function is executed in case of error occurrence.
  * @retval None
  */
void Error_Handler(void)
{
  /* USER CODE BEGIN Error_Handler_Debug */
  /* User can add his own implementation to report the HAL error return state */
  __disable_irq();
  while (1)
  {
  }
  /* USER CODE END Error_Handler_Debug */
}

#ifdef  USE_FULL_ASSERT
/**
  * @brief  Reports the name of the source file and the source line number
  *         where the assert_param error has occurred.
  * @param  file: pointer to the source file name
  * @param  line: assert_param error line source number
  * @retval None
  */
void assert_failed(uint8_t *file, uint32_t line)
{
  /* USER CODE BEGIN 6 */
  /* User can add his own implementation to report the file name and line number,
     ex: printf("Wrong parameters value: file %s on line %d\r\n", file, line) */
  /* USER CODE END 6 */
}
#endif /* USE_FULL_ASSERT */
